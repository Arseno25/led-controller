## sdkconfig.defaults
```kconfig
# --- Main task ---
CONFIG_ESP_MAIN_TASK_STACK_SIZE=8192

# --- Logging ---
CONFIG_LOG_DEFAULT_LEVEL_INFO=y

# --- Partitions ---
CONFIG_PARTITION_TABLE_CUSTOM=y
CONFIG_PARTITION_TABLE_CUSTOM_FILENAME="partitions.csv"

# --- HTTP server ---
CONFIG_HTTPD_MAX_REQ_HDR_LEN=1024
CONFIG_HTTPD_MAX_URI_LEN=512

# --- LWIP ---
CONFIG_LWIP_MAX_SOCKETS=10

# --- FreeRTOS ---
CONFIG_FREERTOS_HZ=1000
```
